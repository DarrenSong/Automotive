## nuttx-f103/apps-overlay/examples/canlight/Kconfig
```kconfig
#
# apps/examples/canlight/Kconfig
#

config EXAMPLES_CANLIGHT
	tristate "CAN RX light control (week8)"
	default n
	depends on CAN
	depends on USERLED
	---help---
		Receive CAN ID 0x202 and drive /dev/userleds.
		data[0] bit0=LED0 (PB5), bit1=LED1 (PE5).
		Also: "canlight <mask>" sends one TX frame for loopback self-test.

if EXAMPLES_CANLIGHT

config EXAMPLES_CANLIGHT_PROGNAME
	string "Program name"
	default "canlight"

config EXAMPLES_CANLIGHT_PRIORITY
	int "canlight NSH task priority"
	default 100

config EXAMPLES_CANLIGHT_STACKSIZE
	int "canlight NSH task stack size"
	default DEFAULT_TASK_STACKSIZE

config EXAMPLES_CANLIGHT_DAEMON_PRIORITY
	int "canlight RX daemon priority"
	default 100

config EXAMPLES_CANLIGHT_DAEMON_STACKSIZE
	int "canlight RX daemon stack size"
	default 2048

config EXAMPLES_CANLIGHT_DEVPATH
	string "CAN device path"
	default "/dev/can0"

config EXAMPLES_CANLIGHT_ID
	hex "RX/TX CAN standard ID for lights"
	default 0x202

endif
```

## nuttx-f103/apps-overlay/examples/canspeed/Kconfig
```kconfig
#
# apps/examples/canspeed/Kconfig
#

config EXAMPLES_CANSPEED
	tristate "CAN vehicle-speed TX demo (week8)"
	default n
	depends on CAN
	depends on SCHED_LPWORK || SCHED_HPWORK
	---help---
		Periodically send std CAN ID 0x201 on /dev/can0.
		Default runs on LPWORK so NSH stays free (like wqblink).
		Use "canspeed fg" for old blocking loop; "canspeed stop" to cancel.

if EXAMPLES_CANSPEED

config EXAMPLES_CANSPEED_PROGNAME
	string "Program name"
	default "canspeed"

config EXAMPLES_CANSPEED_PRIORITY
	int "canspeed task priority"
	default 100

config EXAMPLES_CANSPEED_STACKSIZE
	int "canspeed stack size"
	default DEFAULT_TASK_STACKSIZE

config EXAMPLES_CANSPEED_DEVPATH
	string "CAN device path"
	default "/dev/can0"

config EXAMPLES_CANSPEED_ID
	hex "TX CAN standard ID"
	default 0x201

config EXAMPLES_CANSPEED_INTERVAL_MS
	int "TX period (ms)"
	default 100

config EXAMPLES_CANSPEED_COUNT
	int "Number of frames (0=forever)"
	default 50

endif
```

## nuttx-f103/apps-overlay/examples/ledblink/Kconfig
```kconfig
#
# apps/examples/ledblink/Kconfig
#

config EXAMPLES_LEDBLINK
	tristate "LED blink user-task example (week7)"
	default n
	---help---
		Periodic task demo: usleep + printf, optional /dev/userleds.

if EXAMPLES_LEDBLINK

config EXAMPLES_LEDBLINK_PROGNAME
	string "Program name"
	default "ledblink"

config EXAMPLES_LEDBLINK_PRIORITY
	int "ledblink task priority"
	default 100

config EXAMPLES_LEDBLINK_STACKSIZE
	int "ledblink stack size"
	default DEFAULT_TASK_STACKSIZE

config EXAMPLES_LEDBLINK_INTERVAL_MS
	int "Blink interval (ms)"
	default 500

endif
```

## nuttx-f103/apps-overlay/examples/wqblink/Kconfig
```kconfig
#
# apps/examples/wqblink/Kconfig
#

config EXAMPLES_WQBLINK
	tristate "Work-queue periodic blink (week7)"
	default n
	depends on SCHED_LPWORK || SCHED_HPWORK
	---help---
		Demo: schedule periodic LED/printf work on LPWORK instead of
		a dedicated task looping with usleep().

if EXAMPLES_WQBLINK

config EXAMPLES_WQBLINK_PROGNAME
	string "Program name"
	default "wqblink"

config EXAMPLES_WQBLINK_PRIORITY
	int "wqblink task priority"
	default 100

config EXAMPLES_WQBLINK_STACKSIZE
	int "wqblink stack size"
	default DEFAULT_TASK_STACKSIZE

config EXAMPLES_WQBLINK_INTERVAL_MS
	int "Work period (ms)"
	default 500

endif
```
